## configs/s5pv210_defconfig
```kconfig
BR2_arm=y
BR2_cortex_a8=y
BR2_ARM_EABIHF=y
BR2_ARM_FPU_NEON=y
BR2_ARM_INSTRUCTIONS_ARM=y

BR2_OPTIMIZE_2=y

BR2_TOOLCHAIN_EXTERNAL=y
BR2_TOOLCHAIN_EXTERNAL_CUSTOM=y
BR2_TOOLCHAIN_EXTERNAL_PATH="/mnt/qiang/work/210/toolchain/gcc-4.9.4-glibc-x86_64-arm-buildroot-linux-gnueabihf-3.4/usr"
BR2_TOOLCHAIN_EXTERNAL_GCC_4_9=y
BR2_TOOLCHAIN_EXTERNAL_HEADERS_3_4=y
BR2_TOOLCHAIN_EXTERNAL_CUSTOM_GLIBC=y
BR2_TOOLCHAIN_EXTERNAL_CXX=y

BR2_ROOTFS_DEVICE_CREATION_DYNAMIC_MDEV=y
BR2_TARGET_GENERIC_GETTY=n
BR2_TARGET_GENERIC_REMOUNT_ROOTFS_RW=n
BR2_SYSTEM_DHCP="eth0"
```

## package/dlna/Config.in
```kconfig
config BR2_PACKAGE_DLNA
	bool "dlna"
	depends on BR2_INSTALL_LIBSTDCPP
	help
	  DLNA contains dmr and dms.

comment "dlna support needs a toolchain w/ C++"
	depends on !BR2_INSTALL_LIBSTDCPP
```

## package/ffmpeg3/Config.in
```kconfig
config BR2_PACKAGE_FFMPEG3
	bool "ffmpeg3"
	help
	  FFmpeg is a complete, cross-platform solution to record, convert
	  and stream audio and video.

	  http://www.ffmpeg.org
```

## package/goahead/Config.in
```kconfig
config BR2_PACKAGE_GOAHEAD
	bool "goahead"
	select BR2_PACKAGE_JSON_C
	help
	  HTTP Server.
```

## package/myapp/Config.in
```kconfig
config BR2_PACKAGE_MYAPP
	bool "myapp"
	select BR2_PACKAGE_DBUS
	select BR2_PACKAGE_JSON_C
	help
	  My Tools.
```
